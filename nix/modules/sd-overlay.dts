/dts-v1/;
/plugin/;
#include <dt-bindings/clock/spacemit,k1-syscon.h>

// NixOS's apply_overlays.py only applies an overlay to a base DTB whose
// root compatible intersects the overlay's root compatible, so declare
// the board compatible here (matches k1-bananapi-f3.dts).
/ {
  compatible = "bananapi,bpi-f3", "spacemit,k1";
};

&{/soc/storage-bus} {
  mmc@d4280000 {
    compatible = "spacemit,k1-sdhci";
    reg = <0x0 0xd4280000 0x0 0x200>;
    clocks = <&syscon_apmu CLK_SDH_AXI>,
             <&syscon_apmu CLK_SDH0>;
    clock-names = "core", "io";
    resets = <&syscon_apmu RESET_SDH_AXI>,
             <&syscon_apmu RESET_SDH0>;
    reset-names = "axi", "sdh";
    interrupts = <99>;
    bus-width = <4>;
    broken-cd;
    // microSD slot has no write-protect tab; without this the
    // controller's WP sense reads "protected" and the card mounts
    // read-only (root then fails). Force it writable.
    disable-wp;
    // It's an SD-card slot: not eMMC, not SDIO. no-sdio also avoids the
    // driver's set_uhs_signaling VDD_180 write to HOST_CONTROL2 that
    // faulted (only taken when !NO_SDIO); no-mmc skips the eMMC HS400
    // ops; no-1-8-v keeps it on the 3.3V high-speed path for now.
    no-mmc;
    no-sdio;
    no-1-8-v;
    status = "okay";
  };
};
